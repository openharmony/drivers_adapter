## khdf/liteos/model/storage/Kconfig
```kconfig
config DRIVERS_HDF_STORAGE
    bool "Enable HDF storage driver"
    default n
    depends on DRIVERS_HDF
    help
      Answer Y to enable HDF storage driver.
```
